## CMakeLists.txt
```
cmake_minimum_required(VERSION 3.28.0)
find_package(Zephyr REQUIRED HINTS $ENV{ZEPHYR_BASE})
project(minew_uf2_draft)
include(${ZEPHYR_BASE}/samples/subsys/usb/common/common.cmake)
target_include_directories(app PRIVATE include)
target_sources(app PRIVATE src/main.c src/uf2_draft.c src/virtual_disk.c)
```

## Kconfig
```
mainmenu "Minew UF2 recovery prototype"
source "Kconfig.zephyr"
rsource "../upstream-zephyr/samples/subsys/usb/common/Kconfig.sample_usbd"
```

## prj.conf
```kconfig
CONFIG_USB_DEVICE_STACK_NEXT=y
CONFIG_USBD_MSC_CLASS=y
CONFIG_DISK_ACCESS=y
CONFIG_SAMPLE_USBD_PRODUCT="Minew UF2 DRY RUN"
CONFIG_SAMPLE_USBD_MANUFACTURER="Experimental Minew port"
CONFIG_SAMPLE_USBD_PID=0x0008
CONFIG_MAIN_STACK_SIZE=2048
CONFIG_USE_SEGGER_RTT=y
CONFIG_CONSOLE=y
CONFIG_UART_CONSOLE=n
CONFIG_RTT_CONSOLE=y
CONFIG_LOG=y
CONFIG_LOG_BACKEND_RTT=y
CONFIG_LOG_BACKEND_UART=n
CONFIG_FLASH=n
```

## app.overlay
```dts
/* USB wiring and electrical prerequisites must be verified before runtime use. */
&usbhs_wrapper { status = "okay"; };
zephyr_udc0: &usbhs { status = "okay"; };

&xo24m { status = "okay"; };
&vregusb { status = "okay"; };
```

## src/main.c
```c
/* SPDX-License-Identifier: MIT */
#include <sample_usbd.h>
#include <zephyr/kernel.h>
#include <zephyr/usb/class/usbd_msc.h>
#include <zephyr/storage/disk_access.h>
#include <errno.h>
#include "uf2_draft.h"
#ifndef MINEW_MCUBOOT
static struct uf2_session session;
#else
extern int minew_receive_block(const uint8_t *block);
#endif
static int init(struct disk_info *d){ARG_UNUSED(d);return 0;}
static int read_disk(struct disk_info *d,uint8_t *b,uint32_t start,uint32_t n){
 ARG_UNUSED(d);if(start>=UF2_DISK_SECTORS || n>UF2_DISK_SECTORS-start)return -EINVAL;
 for(uint32_t i=0;i<n;i++) { uf2_disk_read(start+i,b+512*i); }
 return 0;
}
static int write_disk(struct disk_info *d,const uint8_t *b,uint32_t start,uint32_t n){
 ARG_UNUSED(d);if(start>=UF2_DISK_SECTORS || n>UF2_DISK_SECTORS-start)return -EINVAL;
 for(uint32_t i=0;i<n;i++){
  #ifdef MINEW_MCUBOOT
  int r=minew_receive_block(b+512*i);
#else
  int r=uf2_accept(&session,b+512*i);
#endif
  if(r<0)printk("UF2 rejected: %d\n",r);
  #ifndef MINEW_MCUBOOT
  if(r==1 && session.received==session.total)
   printk("UF2 structurally complete: %u blocks. DRY RUN: NOT INSTALLED\n",session.total);
#endif
 }
 /* FAT/metadata writes are acknowledged but not retained, as on a virtual UF2 disk. */
 return 0;
}
static int ioctl_disk(struct disk_info *d,uint8_t cmd,void *p){
 ARG_UNUSED(d);
 switch(cmd){
 case DISK_IOCTL_CTRL_INIT:case DISK_IOCTL_CTRL_DEINIT:case DISK_IOCTL_CTRL_SYNC:return 0;
 case DISK_IOCTL_GET_SECTOR_COUNT:*(uint32_t*)p=UF2_DISK_SECTORS;return 0;
 case DISK_IOCTL_GET_SECTOR_SIZE:*(uint32_t*)p=512;return 0;
 case DISK_IOCTL_GET_ERASE_BLOCK_SZ:*(uint32_t*)p=1;return 0;
 default:return -EINVAL;
 }
}
static const struct disk_operations ops={.init=init,.status=init,.read=read_disk,.write=write_disk,.ioctl=ioctl_disk};
static struct disk_info disk={.name="UF2",.ops=&ops};
USBD_DEFINE_MSC_LUN(uf2,"UF2","Minew","UF2 Draft","0.01");
#ifdef MINEW_MCUBOOT
int minew_usb_init(void){
#else
int main(void){
#endif
 int r=disk_access_register(&disk);if(r)return r;
 struct usbd_context *usb=sample_usbd_init_device(NULL);
 if(!usb)return -ENODEV;
 r=usbd_enable(usb);printk("Minew UF2 USB enable: %d\n",r);
 return r;
}
```

## include/uf2_draft.h
```c
/* SPDX-License-Identifier: MIT */
#ifndef MINEW_UF2_DRAFT_H
#define MINEW_UF2_DRAFT_H
#include <stdint.h>
#define UF2_BASE 0x20000u
#define UF2_LIMIT 0xf0000u
#define UF2_BLOCKS ((UF2_LIMIT-UF2_BASE)/256u)
/* Private experimental identifier; not an upstream registered family ID. */
#define UF2_FAMILY 0x9b7316e2u
struct uf2_session {
 uint32_t total, received;
 uint8_t seen[UF2_BLOCKS/8];
 uint32_t checksums[UF2_BLOCKS];
};
/* 0: ordinary disk data; 1: new block; 2: duplicate; negative: invalid.
 * This parser validates structure only. It never programs or authenticates images.
 */
int uf2_accept(struct uf2_session *s, const uint8_t block[512]);
void uf2_disk_read(uint32_t sector, uint8_t block[512]);
#define UF2_DISK_SECTORS 8192u
#endif
```

## src/uf2_draft.c
```c
/* SPDX-License-Identifier: MIT */
#include "uf2_draft.h"
#include <errno.h>
#include <stddef.h>
static uint32_t le32(const uint8_t *p) {
 return (uint32_t)p[0] | (uint32_t)p[1]<<8 | (uint32_t)p[2]<<16 | (uint32_t)p[3]<<24;
}
static uint32_t crc32(const uint8_t *p, unsigned n) {
 uint32_t c=~0u;
 while(n--) { c^=*p++; for(unsigned j=0;j<8;j++) c=(c>>1)^(0xedb88320u & (0u-(c&1u))); }
 return ~c;
}
int uf2_accept(struct uf2_session *s, const uint8_t b[512]) {
 if(le32(b)!=0x0a324655 || le32(b+4)!=0x9e5d5157) return 0;
 if(le32(b+508)!=0x0ab16f30) return -EINVAL;
 /* Ignore other families completely, including their advertised block count. */
 if(!(le32(b+8)&0x2000) || le32(b+28)!=UF2_FAMILY) return 0;
 if(le32(b+8)!=0x2000 || le32(b+16)!=256) return -EINVAL;
 uint32_t addr=le32(b+12), n=le32(b+20), total=le32(b+24);
 if(!total || total>UF2_BLOCKS || n>=total) return -ERANGE;
 if(addr!=UF2_BASE+n*256u || addr>=UF2_LIMIT) return -ERANGE;
 if(s->total && s->total!=total) return -EINVAL;
 uint32_t crc=crc32(b+32,256);
 if(s->seen[n/8] & (1u<<(n%8))) return s->checksums[n]==crc ? 2 : -EILSEQ;
 s->total=total; s->checksums[n]=crc; s->seen[n/8]|=1u<<(n%8); s->received++;
 return 1;
}
```

## src/virtual_disk.c
```c
/* SPDX-License-Identifier: MIT */
#include "uf2_draft.h"
#include <string.h>
static void p16(uint8_t *p,unsigned n){ p[0]=n; p[1]=n>>8; }
static void p32(uint8_t *p,uint32_t n){ p16(p,n); p16(p+2,n>>16); }
#ifdef MINEW_MCUBOOT
static const char info[]="UF2 Bootloader 0.1 experimental\r\nModel: Minew MX54BE13 nRF54LM20A\r\nBoard-ID: MINEW-MX54BE13-EXPERIMENTAL\r\nCopy a signed, slot-linked UF2 update. MCUboot validates before boot.\r\n";
#else
static const char info[]="UF2 Bootloader draft\r\nModel: Minew MX54BE13 nRF54LM20A\r\nBoard-ID: MINEW-MX54BE13-DRAFT\r\nVALIDATION ONLY: no firmware is written or activated.\r\n";
#endif
void uf2_disk_read(uint32_t sector,uint8_t b[512]) {
 memset(b,0,512);
 if(sector==0) {
  b[0]=0xeb;b[1]=0x3c;b[2]=0x90;memcpy(b+3,"MSDOS5.0",8);
  p16(b+11,512);b[13]=1;p16(b+14,1);b[16]=2;p16(b+17,64);
  p16(b+19,UF2_DISK_SECTORS);b[21]=0xf8;p16(b+22,32);
  p16(b+24,32);p16(b+26,64);b[36]=0x80;b[38]=0x29;
  p32(b+39,0x54323041);memcpy(b+43,"MINEWBOOT  ",11);memcpy(b+54,"FAT16   ",8);
  b[510]=0x55;b[511]=0xaa;
 } else if(sector==1 || sector==33) {
  p16(b,0xfff8);p16(b+2,0xffff);p16(b+4,0xffff);
 } else if(sector==65) {
  memcpy(b,"MINEWBOOT  ",11);b[11]=8;
  memcpy(b+32,"INFO_UF2TXT",11);b[43]=0x21;
  p16(b+58,2);p32(b+60,sizeof(info)-1);
 } else if(sector==69) memcpy(b,info,sizeof(info)-1);
}
```
