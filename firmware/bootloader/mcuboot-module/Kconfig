## firmware/port/boards/minew/mx54be13/Kconfig.mx54be13
```kconfig
config BOARD_MX54BE13
	select SOC_NRF54LM20A_CPUAPP if BOARD_MX54BE13_NRF54LM20A_CPUAPP
```

## firmware/port/boards/minew/mx54be13/board.yml
```yaml
board:
  name: mx54be13
  full_name: Minew MX54BE13 nRF54LM20A
  vendor: minew
  socs:
    - name: nrf54lm20a
```

## firmware/port/boards/minew/mx54be13/mx54be13_nrf54lm20a_cpuapp_defconfig
```kconfig
CONFIG_GPIO=y
CONFIG_ARM_MPU=y
CONFIG_NULL_POINTER_EXCEPTION_DETECTION_NONE=y
CONFIG_CACHE_MANAGEMENT=y
CONFIG_EXTERNAL_CACHE=y
CONFIG_NRF_GRTC_START_SYSCOUNTER=y
CONFIG_USE_DT_CODE_PARTITION=y
```

## firmware/port/compat/Kconfig
```kconfig
config KSCAN
 bool "Legacy keyboard-scan API compatibility"
config KSCAN_INIT_PRIORITY
 int "Legacy keyboard-scan initialization priority"
 default 90
config KSCAN_LOG_LEVEL
 int
 default 3
config MINEW_MANUAL_KEY
 bool
 default y if DT_HAS_MINEW_KSCAN_MANUAL_ENABLED
 depends on KSCAN
config MINEW_UF2_BOOTLOADER
 bool "Minew MCUboot UF2 recovery entry"
 depends on BOOTLOADER_MCUBOOT && SOC_NRF54LM20A
 default n
```

## firmware/port/compat/dts/bindings/minew,kscan-manual.yaml
```yaml
description: Debugger-triggered one-key scan input for bring-up
compatible: "minew,kscan-manual"
include: base.yaml
```

## firmware/port/manifest/west.yml
```yaml
manifest:
  projects:
    - name: zephyr
      url: https://github.com/zephyrproject-rtos/zephyr
      revision: 0534e997eacb94bae1df6c9a7dd4a9a6cbf1cecf
      import:
        name-allowlist: [cmsis, cmsis_6, hal_nordic, picolibc, segger, tinycrypt, mbedtls, tf-psa-crypto, tf-psa-crypto-drivers, zcbor]
    - name: mcuboot
      url: https://github.com/mcu-tools/mcuboot
      revision: 725d63c9d5bc1bb572d802e7a768daf504186daf
      path: bootloader/mcuboot
    - name: nanopb
      url: https://github.com/zmkfirmware/nanopb
      revision: 8c60555d6277a0360c876bd85d491fc4fb0cd74a
      path: modules/lib/nanopb
    - name: zmk-studio-messages
      url: https://github.com/zmkfirmware/zmk-studio-messages
      revision: 6cb4c283e76209d59c45fbcb218800cd19e9339d
      path: modules/msgs/zmk-studio-messages
    - name: lvgl
      url: https://github.com/zephyrproject-rtos/lvgl
      revision: 8a6a2d1d29d17d1e4bdc94c243c146a39d635fdd
      path: modules/lib/gui/lvgl
  self:
    path: manifest
```
