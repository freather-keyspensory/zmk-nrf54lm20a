## CMakeLists.txt
```
cmake_minimum_required(VERSION 3.20.0)
find_package(Zephyr REQUIRED HINTS $ENV{ZEPHYR_BASE})
project(minew_bringup)
target_sources(app PRIVATE src/main.c)
```

## prj.conf
```kconfig
CONFIG_SERIAL=n
CONFIG_CONSOLE=y
CONFIG_UART_CONSOLE=n
CONFIG_USE_SEGGER_RTT=y
CONFIG_RTT_CONSOLE=y
CONFIG_PRINTK=y
CONFIG_LOG=y
CONFIG_LOG_BACKEND_RTT=y
CONFIG_LOG_BACKEND_UART=n
CONFIG_DEBUG=y
CONFIG_ASSERT=y
CONFIG_MINIMAL_LIBC=y
```

## src/main.c
```c
#include <zephyr/kernel.h>
#include <zephyr/sys/printk.h>
int main(void) {
 printk("MINEW MX54BE13 bringup boot\n");
 unsigned int heartbeat = 0;
 while (1) {
  printk("MINEW heartbeat %u uptime %lld\n", heartbeat++, k_uptime_get());
  k_sleep(K_SECONDS(2));
 }
 return 0;
}
```
